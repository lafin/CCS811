// xxd -i CCS811_FW_cAppV1-1-0_XX000000_vLatest.bin
const char bin[] = {
  0x15, 0xa7, 0xd3, 0x16, 0x70, 0x5e, 0x39, 0xbd, 0xfc, 0x88, 0x80, 0x49,
  0x02, 0xdc, 0x17, 0x10, 0x88, 0x90, 0xbe, 0xe5, 0xec, 0x71, 0x01, 0xb6,
  0x8c, 0xf0, 0x56, 0xc7, 0xa5, 0xce, 0x1e, 0x1d, 0xb3, 0xd9, 0x4b, 0x9d,
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  0x14, 0xa0, 0xdb, 0x51
};

#include "CCS811.h"

// D0 -> WAK
// D1 -> SCL
// D2 -> SDA
// 3V -> VCC
// G -> GND
// D6 -> RST

#define ADDRESS 0x5A
#define RESET_PIN D6
#define WAKE_PIN D0

CCS811 sensor;
int INDEX = 100;

void setup()
{
  Serial.begin(115200);
  Serial.println("run");

  delay(1 * INDEX);
  Wire.begin();

  delay(1 * INDEX);
  pinMode(WAKE_PIN, OUTPUT);
  digitalWrite(RESET_PIN, LOW); delay(1 * INDEX);
  digitalWrite(RESET_PIN, HIGH); delay(1 * INDEX);

  digitalWrite(WAKE_PIN, LOW); delay(1 * INDEX);
  byte hw_id = sensor.readByte(ADDRESS, HW_ID);
  if (hw_id != 0x81)
  {
    Serial.println("Error: Incorrect Hardware ID detected.");
    return;
  }

  uint8_t FWBootVersion[2] = {0, 0}, FWAppVersion[2] = {0, 0};
  sensor.readBytes(ADDRESS, FW_BOOT_VERSION, 2, &FWBootVersion[0]);
  Serial.print("CCS811 Firmware Boot Version: ");
  sensor.printVersion(FWBootVersion);

  sensor.readBytes(ADDRESS, FW_APP_VERSION, 2, &FWAppVersion[0]);
  Serial.print("CCS811 Firmware App Version: ");
  sensor.printVersion(FWAppVersion);

  uint8_t status = sensor.readByte(ADDRESS, STATUS);
  if ((status & 0x80) == 0x80) {
    sensor.reset(); delay(1 * INDEX);

    status = sensor.readByte(ADDRESS, STATUS);
    if ((status & 0x80) != 0x00) {
      Serial.println("reset failed 1");
    }
    delay(1 * INDEX);

    status = sensor.readByte(ADDRESS, STATUS);
    if ((status & 0x80) != 0x00) {
      Serial.println("reset failed 2");
      return;
    }
  }

  // Erase application
  status = sensor.readByte(ADDRESS, STATUS);
  if ((status & 0x10) == 0x10) {
    Wire.beginTransmission(ADDRESS);
    Wire.write(0xF1);
    Wire.write(0xE7);
    Wire.write(0xA7);
    Wire.write(0xE6);
    Wire.write(0x09);
    Wire.endTransmission();
    delay(5 * INDEX);

    status = sensor.readByte(ADDRESS, STATUS);
    if ((status & 0x10) != 0x00) {
      Serial.println("erase failed 3");
    }
    delay(1 * INDEX);

    status = sensor.readByte(ADDRESS, STATUS);
    if ((status & 0x10) != 0x00) {
      Serial.println("erase failed 4");
      return;
    }
  }

  int length = (sizeof(bin) / sizeof(bin[0]));
  Serial.println(length);

  digitalWrite(WAKE_PIN, LOW); delay(1 * INDEX);
  for (int i = 0; i < length; i += 8) {
    Wire.beginTransmission(ADDRESS);
    Wire.write(0xF2);
    for (int j = 0; j < 8; j++)
    {
      Serial.print(".");
      Wire.write(bin[i + j]);
    }
    Wire.endTransmission();
    Serial.println();
    delay(0.5 * INDEX);
  }
  digitalWrite(WAKE_PIN, HIGH);
  Serial.println();

  // Verify application
  Wire.beginTransmission(ADDRESS);
  Wire.write(0xF3);
  Wire.endTransmission();
  delay(5 * INDEX);

  // Status
  Wire.beginTransmission(ADDRESS);
  Wire.write(0x00);
  Wire.endTransmission();

  // Read status
  uint8_t buffer[61];
  Wire.requestFrom(ADDRESS, 1);
  if (Wire.available() == 1) {
    for (int i = 0; i < 1; i++)
    {
      buffer[i] = Wire.read();
    }
  }
  if ((buffer[0] & 0x30) == 0x30) {
    Serial.println("program code valid");
  }
  else {
    Serial.println("program code invalid");
  }
}

void loop()
{

}

